#include "transport_web.h"
#include "hub.h"
#include "ota.h"
#include "radio_espnow.h"
#include <WiFi.h>
#include <WebServer.h>
#include <DNSServer.h>
#include <string.h>
#include "web_page.h"          // generated by tools/build_web.py — include from this TU only

// Threading: every handler below runs on the core-0 net task (poll() -> handleClient()).
// The JsonDocuments are created and destroyed inside the handler; shared hub state is read
// through hub:: (which copies under its own locks). Stats are plain 32-bit volatiles.
//
// POST /cmd body: the route is registered with a raw-body callback (server.raw()), so the
// body reaches us byte-for-byte whatever the Content-Type — application/json from the page or
// x-www-form-urlencoded from a bare `curl -d '{...}'` (the WebServer's form parser would drop
// a field without '='). Capped at CMD_MAX_BODY. Every /cmd reply is HTTP 200; errors are in
// the JSON ("bad_json" = unparseable/oversize body, "bad_cmd", "bad_arg", "hub_only").
//
// POST /ota (Phase 4): multipart upload of LED_Sign_ota.bin into the inactive app slot. The chunk callback
// drives ota::upload*() (Update) and pumps the radio between chunks so the mesh keeps its Shows during the
// ~10-20 s transfer (we ARE the net task, so radio::pump() is legal here). Refused while a node OTA is
// queued/in flight. Reply {"ok","size","err"}; on success the reboot is armed for +1 s and happens in
// ota::tick() on core 1, after the reply has been sent. GET /ota returns the /state.ota object.

namespace transport_web {

static WebServer  server(80);
static DNSServer  dns;
static CmdHandler handler = nullptr;

static volatile uint32_t reqs = 0;
static volatile uint32_t lastIp = 0;
static volatile uint8_t  staCount = 0;
static uint32_t lastStaAt = 0;

static void noteRequest() {
  reqs = reqs + 1;
  lastIp = (uint32_t)server.client().remoteIP();
}

static void jsonHeaders() {
  server.sendHeader("Cache-Control", "no-store");
  server.sendHeader("Access-Control-Allow-Origin", "*");
}

static void handleRoot() {
  noteRequest();
  server.sendHeader("Content-Encoding", "gzip");
  server.sendHeader("Cache-Control", "no-store");
  server.send_P(200, "text/html", (PGM_P)WEB_INDEX_GZ, WEB_INDEX_GZ_LEN);
}

static void redirectRoot() {
  noteRequest();
  server.sendHeader("Location", "http://192.168.4.1/", true);
  server.sendHeader("Cache-Control", "no-store");
  server.send(302, "text/plain", "");
}

static void handleState() {
  noteRequest();
  JsonDocument doc;
  hub::buildState(doc.to<JsonObject>());
  String out; out.reserve(2560);
  serializeJson(doc, out);
  jsonHeaders();
  server.send(200, "application/json", out);
}

// Raw body collector for POST /cmd (called by the WebServer parser before handleCmd)
static char   bodyBuf[CMD_MAX_BODY + 1];
static size_t bodyLen = 0;
static bool   bodyOverflow = false;

static void cmdBodyChunk() {
  HTTPRaw& raw = server.raw();
  if (raw.status == RAW_START) { bodyLen = 0; bodyOverflow = false; bodyBuf[0] = 0; return; }
  if (raw.status != RAW_WRITE) return;
  size_t room = CMD_MAX_BODY - bodyLen;
  size_t n = raw.currentSize;
  if (n > room) { n = room; bodyOverflow = true; }
  memcpy(bodyBuf + bodyLen, raw.buf, n);
  bodyLen += n;
  bodyBuf[bodyLen] = 0;
}

static void handleCmd() {
  noteRequest();
  String body = bodyLen ? String(bodyBuf) : server.arg("plain");
  bool overflow = bodyOverflow;
  bodyLen = 0; bodyOverflow = false; bodyBuf[0] = 0;
  JsonDocument reply;
  if (overflow || body.length() > CMD_MAX_BODY) {
    reply["ok"] = false; reply["err"] = "bad_json"; reply["note"] = "body > 512 B";
  } else {
    JsonDocument cmd;
    DeserializationError e = deserializeJson(cmd, body);
    if (e || !cmd.is<JsonObject>()) {
      reply["ok"] = false; reply["err"] = "bad_json";
    } else {
      bool ok = handler ? handler(cmd, reply) : false;
      if (!ok && reply["err"].isNull()) reply["err"] = "bad_cmd";
      reply["ok"] = ok;
    }
  }
  String out; out.reserve(1536);
  serializeJson(reply, out);
  jsonHeaders();
  server.send(200, "application/json", out);
  Serial.printf("[WEB] POST /cmd %.120s -> %.160s\n", body.c_str(), out.c_str());
}

static void otaChunk() {
  HTTPUpload& up = server.upload();
  switch (up.status) {
    case UPLOAD_FILE_START:
      noteRequest();
      Serial.printf("[WEB] POST /ota \"%s\" from %s\n", up.filename.c_str(), server.client().remoteIP().toString().c_str());
      ota::uploadBegin(hub::otaBusy() ? "node update in progress" : nullptr);
      break;
    case UPLOAD_FILE_WRITE:
      ota::uploadWrite(up.buf, up.currentSize);
      radio::pump();
      break;
    case UPLOAD_FILE_END:
      ota::uploadEnd(up.totalSize);
      break;
    case UPLOAD_FILE_ABORTED:
      ota::uploadAbort();
      break;
    default:
      break;
  }
}

static void otaDone() {
  uint32_t bytes; const char* err;
  bool ok = ota::uploadResult(bytes, err);
  JsonDocument reply;
  reply["ok"] = ok;
  reply["size"] = bytes;
  reply["err"] = err;
  if (ok) reply["note"] = "rebooting in 1 s";
  String out;
  serializeJson(reply, out);
  jsonHeaders();
  server.sendHeader("Connection", "close");
  server.send(200, "application/json", out);
  Serial.printf("[WEB] POST /ota -> %s\n", out.c_str());
  if (ok) ota::requestReboot(1000);
}

static void handleOtaGet() {
  noteRequest();
  JsonDocument doc;
  hub::buildOta(doc.to<JsonObject>());
  String out;
  serializeJson(doc, out);
  jsonHeaders();
  server.send(200, "application/json", out);
}

static void handleNotFound() {
  Serial.printf("[WEB] %s %s -> 302 /\n", server.method() == HTTP_POST ? "POST" : "GET", server.uri().c_str());
  redirectRoot();
}

struct WebTransport : public Transport {
  void begin() override {
    IPAddress ip = WiFi.softAPIP();
    dns.start(53, "*", ip);
    server.on("/", HTTP_GET, handleRoot);
    server.on("/index.html", HTTP_GET, handleRoot);
    server.on("/cmd", HTTP_POST, handleCmd, cmdBodyChunk);
    server.on("/state", HTTP_GET, handleState);
    server.on("/ota", HTTP_POST, otaDone, otaChunk);
    server.on("/ota", HTTP_GET, handleOtaGet);
    static const char* const PROBES[] = { "/generate_204", "/gen_204", "/hotspot-detect.html", "/library/test/success.html",
                                          "/connecttest.txt", "/ncsi.txt", "/fwlink", "/redirect", "/success.txt",
                                          "/canonical.html", "/check_network_status.txt" };
    for (auto p : PROBES) server.on(p, HTTP_ANY, redirectRoot);
    server.onNotFound(handleNotFound);
    server.begin();
    Serial.printf("[WEB] listening on %s (SSID %s)\n", ip.toString().c_str(), WiFi.softAPSSID().c_str());
  }
  void poll() override {
    server.handleClient();
    dns.processNextRequest();
    uint32_t now = millis();
    if (now - lastStaAt >= 1000) { lastStaAt = now; staCount = WiFi.softAPgetStationNum(); }
  }
  void sendEvent(const char*) override {}
  void setCommandHandler(CmdHandler fn) override { handler = fn; }
};

static WebTransport inst;
Transport& instance() { return inst; }

uint32_t reqCount()     { return reqs; }
uint32_t lastClientIp() { return lastIp; }
uint8_t  apClients()    { return staCount; }

} // namespace transport_web
