#include "ota.h"
#include "radio_espnow.h"
#include <WiFi.h>
#include <HTTPClient.h>
#include <Update.h>
#include <esp_ota_ops.h>
#include <esp_partition.h>
#include <esp_app_desc.h>
#include <esp_image_format.h>
#include <esp_wifi.h>
#include <string.h>

#if __has_include("build_id.h")
#include "build_id.h"          // generated by tools/make_images.sh (gitignored): #define BUILD_GIT "<short hash>"
#endif
#ifndef BUILD_GIT
#define BUILD_GIT "dev"        // IDE / plain arduino-cli build without make_images.sh
#endif

// Arduino core hook (cores/esp32/esp32-hal-misc.c, weak C symbol): returning true stops initArduino() from
// confirming a PENDING_VERIFY image at boot. We confirm in ota::tick() after OTA_VERIFY_MS of health.
extern "C" bool verifyRollbackLater() { return true; }

namespace ota {

// ---------------- identity / rollback (immutable after begin(), except the flags) ----------------
static uint8_t  bid[4] = {0};
static char     slot[17] = "?";
static uint32_t imgLen = 0;
static const esp_partition_t* running = nullptr;
static volatile bool pending = false;         // running image is PENDING_VERIFY and not yet confirmed
static volatile uint32_t rebootAt = 0;        // 0 = none

void buildIdHex(const uint8_t* id, char out9[9]) {
  snprintf(out9, 9, "%02x%02x%02x%02x", id[0], id[1], id[2], id[3]);
}

const uint8_t* buildId()  { return bid; }
const char* versionStr()  { return FW_VERSION_STR; }
const char* gitStr()      { return BUILD_GIT; }
const char* slotName()    { return slot; }
uint32_t    imageLen()    { return imgLen; }
bool        pendingVerify() { return pending; }

uint32_t verifyLeftMs() {
  if (!pending) return 0;
  uint32_t now = millis();
  return now >= OTA_VERIFY_MS ? 0 : OTA_VERIFY_MS - now;
}

static const char* stateName(esp_ota_img_states_t s) {
  switch (s) {
    case ESP_OTA_IMG_NEW:            return "NEW";
    case ESP_OTA_IMG_PENDING_VERIFY: return "PENDING_VERIFY";
    case ESP_OTA_IMG_VALID:          return "VALID";
    case ESP_OTA_IMG_INVALID:        return "INVALID";
    case ESP_OTA_IMG_ABORTED:        return "ABORTED";
    case ESP_OTA_IMG_UNDEFINED:      return "UNDEFINED";
    default:                         return "?";
  }
}

void begin(bool hub) {
  const esp_app_desc_t* d = esp_app_get_description();
  memcpy(bid, d->app_elf_sha256, 4);
  running = esp_ota_get_running_partition();
  if (running) { strncpy(slot, running->label, sizeof(slot) - 1); slot[sizeof(slot) - 1] = 0; }

  esp_ota_img_states_t rs;
  esp_err_t re = running ? esp_ota_get_state_partition(running, &rs) : ESP_FAIL;
  pending = (re == ESP_OK && rs == ESP_OTA_IMG_PENDING_VERIFY);
  char hex[9]; buildIdHex(bid, hex);
  Serial.printf("[OTA] running %s @0x%06x state=%s buildId=%s fw %s (git %s)\n", slot,
                running ? (unsigned)running->address : 0u, re == ESP_OK ? stateName(rs) : "n/a (no otadata entry)",
                hex, FW_VERSION_STR, BUILD_GIT);
  if (pending) Serial.printf("[OTA] new image: confirming after %d s healthy, a reset before that rolls back\n", OTA_VERIFY_MS / 1000);

  const esp_partition_t* other = esp_ota_get_next_update_partition(nullptr);
  esp_ota_img_states_t os;
  if (other && esp_ota_get_state_partition(other, &os) == ESP_OK && (os == ESP_OTA_IMG_ABORTED || os == ESP_OTA_IMG_INVALID))
    Serial.printf("[OTA] previous image in %s was rolled back (state %s)\n", other->label, stateName(os));

  if (hub && running) {
    esp_partition_pos_t pos = { running->address, running->size };
    esp_image_metadata_t meta;
    uint32_t t0 = millis();
    if (esp_image_get_metadata(&pos, &meta) == ESP_OK && meta.image_len > 0 && meta.image_len <= running->size) {
      imgLen = meta.image_len;
      Serial.printf("[OTA] image length %u B (%u ms)\n", (unsigned)imgLen, (unsigned)(millis() - t0));
    } else {
      Serial.println("[OTA] image length unknown: node OTA disabled");
    }
  }
}

void requestReboot(uint32_t inMs) { uint32_t t = millis() + inMs; rebootAt = t ? t : 1; }

void tick(bool healthy) {
  uint32_t now = millis();
  if (pending && now >= OTA_VERIFY_MS && healthy) {
    esp_err_t e = esp_ota_mark_app_valid_cancel_rollback();
    pending = false;
    if (e == ESP_OK) Serial.printf("[OTA] image marked valid (slot %s)\n", slot);
    else             Serial.printf("[OTA] mark valid FAILED: %s\n", esp_err_to_name(e));
  }
#ifdef OTA_SELFTEST_FAIL
  if (pending && now > 10000) { Serial.println("[OTA] OTA_SELFTEST_FAIL: rebooting before confirm"); delay(50); ESP.restart(); }
#endif
  if (rebootAt && (int32_t)(now - rebootAt) >= 0) {
    Serial.println("[OTA] rebooting");
    Serial.flush();
    delay(20);
    ESP.restart();
  }
}

void printStatus() {
  char hex[9]; buildIdHex(bid, hex);
  Serial.printf("fw %s (git %s) buildId %s slot %s valid=%d%s imageLen=%u\n", FW_VERSION_STR, BUILD_GIT, hex, slot,
                pending ? 0 : 1, pending ? " (pending verify)" : "", (unsigned)imgLen);
}

// ---------------- hub: firmware server ----------------
static uint8_t  ioBuf[4096];                  // fw server: flash -> socket. Node task: socket -> Update. Never both (role).
static volatile bool     serving = false;
static volatile uint32_t served = 0, transfers = 0;
static TaskHandle_t fwTaskH = nullptr;

bool     fwServing()   { return serving; }
uint32_t fwServed()    { return served; }
uint32_t fwTransfers() { return transfers; }

static bool writeAll(NetworkClient& c, const uint8_t* p, size_t n) {
  size_t w = 0; uint32_t t = millis();
  while (w < n) {
    size_t k = c.write(p + w, n - w);
    if (k > 0) { w += k; t = millis(); continue; }
    if (!c.connected() || millis() - t > 5000) return false;
    vTaskDelay(1);
  }
  return true;
}

static void serveClient(NetworkClient& c) {
  // Request line + headers (bounded: 2 KB / 2 s); only the first line matters.
  char req[96]; size_t rl = 0; bool gotLine = false; uint32_t tail = 0, total = 0, t0 = millis();
  while (millis() - t0 < 2000 && total < 2048) {
    if (c.available() <= 0) { if (!c.connected()) break; vTaskDelay(1); continue; }
    int ch = c.read();
    if (ch < 0) continue;
    total++;
    if (!gotLine) { if (ch == '\n') gotLine = true; else if (ch != '\r' && rl < sizeof(req) - 1) req[rl++] = (char)ch; }
    tail = (tail << 8) | (uint8_t)ch;
    if (tail == 0x0D0A0D0A || (tail & 0xFFFF) == 0x0A0A) break;
  }
  req[rl] = 0;
  IPAddress ip = c.remoteIP();
  char hdr[160];
  bool isGet = strncmp(req, "GET /fw.bin", 11) == 0 && (req[11] == ' ' || req[11] == 0);
  if (!isGet || !imgLen || !running) {
    int n = snprintf(hdr, sizeof(hdr), "HTTP/1.0 %s\r\nContent-Length: 0\r\nConnection: close\r\n\r\n",
                     !isGet ? "404 Not Found" : "503 Service Unavailable");
    writeAll(c, (const uint8_t*)hdr, n);
    c.stop();
    Serial.printf("[OTA] fw server: %s \"%.60s\" -> %s\n", ip.toString().c_str(), req, !isGet ? "404" : "503");
    return;
  }
  int n = snprintf(hdr, sizeof(hdr), "HTTP/1.0 200 OK\r\nContent-Type: application/octet-stream\r\nContent-Length: %u\r\n"
                   "Connection: close\r\n\r\n", (unsigned)imgLen);
  serving = true; served = 0;
  uint32_t ts = millis();
  Serial.printf("[OTA] fw server: %s GET /fw.bin, sending %u B\n", ip.toString().c_str(), (unsigned)imgLen);
  bool ok = writeAll(c, (const uint8_t*)hdr, n);
  uint32_t off = 0;
  while (ok && off < imgLen) {
    size_t k = imgLen - off; if (k > sizeof(ioBuf)) k = sizeof(ioBuf);
    if (esp_partition_read(running, off, ioBuf, k) != ESP_OK) { ok = false; break; }
    if (!writeAll(c, ioBuf, k)) { ok = false; break; }
    off += k; served = off;
  }
  c.stop();
  serving = false;
  transfers = transfers + 1;
  Serial.printf("[OTA] fw server: %s %s %u/%u B in %u ms\n", ip.toString().c_str(), ok ? "done" : "ABORTED",
                (unsigned)off, (unsigned)imgLen, (unsigned)(millis() - ts));
}

static void fwTask(void*) {
  static NetworkServer srv(OTA_PORT);
  srv.begin();
  Serial.printf("[OTA] fw server listening on :%d (%u B image)\n", OTA_PORT, (unsigned)imgLen);
  for (;;) {
    NetworkClient c = srv.accept();             // one client at a time: the next waits in the backlog
    if (!c) { vTaskDelay(pdMS_TO_TICKS(20)); continue; }
    serveClient(c);
  }
}

bool startFwServer() {
  if (fwTaskH) return true;
  if (!imgLen) return false;
  return xTaskCreatePinnedToCore(fwTask, "fwsrv", 8192, nullptr, 1, &fwTaskH, 0) == pdPASS;
}

// ---------------- hub: POST /ota upload ----------------
static volatile bool upActive = false;
static bool     upOk = false;
static uint32_t upBytes = 0, upNextLog = 0, upT0 = 0;
static char     upErr[48] = "";

static void upFail(const char* why) {
  if (upErr[0]) return;                       // keep the first reason
  strncpy(upErr, why, sizeof(upErr) - 1); upErr[sizeof(upErr) - 1] = 0;
  if (Update.isRunning()) Update.abort();
  Serial.printf("[OTA] hub upload failed: %s\n", upErr);
}

void uploadBegin(const char* rejectReason) {
  upActive = true; upOk = false; upBytes = 0; upErr[0] = 0; upNextLog = 100 * 1024; upT0 = millis();
  if (rejectReason) { upFail(rejectReason); return; }
  if (Update.isRunning()) Update.abort();
  if (!Update.begin(UPDATE_SIZE_UNKNOWN)) { upFail(Update.errorString()); return; }
  Serial.println("[OTA] hub upload started");
}

void uploadWrite(uint8_t* buf, size_t n) {
  if (upErr[0] || !n) return;
  if (Update.write(buf, n) != n) { upFail(Update.errorString()); return; }
  upBytes += n;
  if (upBytes >= upNextLog) { Serial.printf("[OTA] hub upload %u kB\n", (unsigned)(upBytes / 1024)); upNextLog += 100 * 1024; }
}

void uploadEnd(size_t total) {
  if (!upErr[0]) {
    if (!total || !upBytes) upFail("empty file");
    else if (!Update.end(true)) upFail(Update.errorString());
    else {
      upOk = true;
      Serial.printf("[OTA] hub upload OK: %u B in %u ms -> boots from the other slot next\n", (unsigned)upBytes,
                    (unsigned)(millis() - upT0));
    }
  }
  upActive = false;
}

void uploadAbort() {
  upFail("upload aborted");
  upActive = false;
}

bool uploadActive() { return upActive; }

bool uploadResult(uint32_t& bytes, const char*& err) {
  bytes = upBytes;
  err = upErr[0] ? upErr : (upOk ? "" : "no upload");
  return upOk;
}

// ---------------- node: pull the hub's image ----------------
static OtaEnter nreq;
static volatile uint8_t nResult = NODE_IDLE, nPct = 0, nPhase = OTA_ST_JOINING;
static char nMsg[24] = "";
static char nErrBuf[24];

NodeResult  nodeResult() { return (NodeResult)nResult; }
uint8_t     nodePct()    { return nPct; }
uint8_t     nodePhase()  { return nPhase; }
const char* nodeMsg()    { return nMsg; }
void        nodeReset()  { if (nResult != NODE_RUNNING) { nResult = NODE_IDLE; nPct = 0; nMsg[0] = 0; } }

// Returns nullptr on success, else a short reason. Runs in the node OTA task.
static const char* nodeRun(HTTPClient& http, NetworkClient& cl) {
  uint32_t t0 = millis();
  char ssid[33], pass[33];
  memcpy(ssid, nreq.ssid, 32); ssid[32] = 0;
  memcpy(pass, nreq.pass, 32); pass[32] = 0;

  WiFi.setSleep(false);
  WiFi.setAutoReconnect(false);
  Serial.printf("[OTA] joining %s on channel %d\n", ssid, ESPNOW_CHANNEL);
  WiFi.begin(ssid, pass, ESPNOW_CHANNEL, nreq.bssid);     // directed: hub BSSID on channel 6, no scan
  while (WiFi.status() != WL_CONNECTED) {
    if (millis() - t0 > OTA_JOIN_MS) return "join timeout";
    vTaskDelay(pdMS_TO_TICKS(50));
  }
  if (!radio::channelOk()) return "channel changed";
  Serial.printf("[OTA] joined in %u ms, ip %s, channel %d\n", (unsigned)(millis() - t0), WiFi.localIP().toString().c_str(),
                (int)WiFi.channel());

  nPhase = OTA_ST_DOWNLOADING;
  http.setConnectTimeout(5000);
  http.setTimeout(10000);
  http.setReuse(false);
  IPAddress hubIp(nreq.ip);
  if (!http.begin(cl, hubIp.toString(), nreq.port, "/fw.bin")) return "http begin";
  int code = http.GET();
  if (code != 200) { snprintf(nErrBuf, sizeof(nErrBuf), "http %d", code); return nErrBuf; }
  int len = http.getSize();
  if (len <= 0 || (uint32_t)len != nreq.size) { snprintf(nErrBuf, sizeof(nErrBuf), "size %d != %u", len, (unsigned)nreq.size); return nErrBuf; }
  Serial.printf("[OTA] GET /fw.bin %d B\n", len);
  if (!Update.begin((size_t)len)) return Update.errorString();

  NetworkClient* s = http.getStreamPtr();
  uint32_t got = 0, lastData = millis(); uint8_t lastLogged = 0;
  while (got < (uint32_t)len) {
    uint32_t now = millis();
    if (now - t0 > OTA_NODE_DL_MS) return "timeout";
    int avail = s ? s->available() : 0;
    if (avail > 0) {
      size_t want = (size_t)avail;
      if (want > sizeof(ioBuf)) want = sizeof(ioBuf);
      if (want > (uint32_t)len - got) want = (uint32_t)len - got;
      int n = s->read(ioBuf, want);
      if (n > 0) {
        if (Update.write(ioBuf, (size_t)n) != (size_t)n) return Update.errorString();
        got += (uint32_t)n; lastData = now;
        nPct = (uint8_t)((uint64_t)got * 100 / (uint32_t)len);
        if (nPct / 10 != lastLogged / 10) { lastLogged = nPct; Serial.printf("[OTA] %u %%\n", nPct); }
        continue;
      }
    }
    if (!s || !s->connected()) { if (s && s->available() > 0) continue; return "connection closed"; }
    if (now - lastData > OTA_STALL_MS) return "stalled";
    vTaskDelay(pdMS_TO_TICKS(2));
  }
  if (!Update.end(true)) return Update.errorString();
  Serial.printf("[OTA] Update OK: %u B in %u ms\n", (unsigned)got, (unsigned)(millis() - t0));
  return nullptr;
}

static void nodeTask(void*) {
  const char* err;
  {
    NetworkClient cl;
    HTTPClient http;
    err = nodeRun(http, cl);
    http.end();
  }
  if (err) {
    strncpy(nMsg, err, sizeof(nMsg) - 1); nMsg[sizeof(nMsg) - 1] = 0;
    if (Update.isRunning()) Update.abort();                 // old slot untouched; otadata only changes on end(true)
    WiFi.disconnect(false);                                 // keep STA mode for ESP-NOW
    esp_wifi_set_channel(ESPNOW_CHANNEL, WIFI_SECOND_CHAN_NONE);
    Serial.printf("[OTA] FAILED: %s (channel %d %s)\n", nMsg, (int)WiFi.channel(), radio::channelOk() ? "OK" : "MISMATCH");
    nResult = NODE_FAILED;
  } else {
    nPct = 100;
    nResult = NODE_OK;                                      // node::tick() reports VERIFIED and restarts
  }
  vTaskDelete(nullptr);
}

bool nodeStart(const OtaEnter& e) {
  if (nResult == NODE_RUNNING) return false;
  memcpy(&nreq, &e, sizeof(nreq));
  nPct = 0; nPhase = OTA_ST_JOINING; nMsg[0] = 0;
  nResult = NODE_RUNNING;
  if (xTaskCreatePinnedToCore(nodeTask, "ota", 8192, nullptr, 1, nullptr, 0) != pdPASS) {
    strncpy(nMsg, "no task", sizeof(nMsg) - 1);
    nResult = NODE_FAILED;
    return false;
  }
  return true;
}

} // namespace ota
